## Kconfig
```kconfig
mainmenu "MiniRV NPC Configuration"

menu "Difftest"

config DIFFTEST
  bool "Enable differential testing against NEMU"
  default n

endmenu

menu "Build options"

choice
  prompt "Build type"
  default BUILD_DEBUG

config BUILD_DEBUG
  bool "Debug"

config BUILD_RELEASE
  bool "Release"

endchoice

endmenu

menu "Trace"

config ITRACE
  bool "Enable instruction trace"
  default y

config MTRACE
  bool "Enable memory trace"
  default n

config DTRACE
  bool "Enable device trace"
  default n

config FTRACE
  bool "Enable function trace"
  default n

config DUMP_WAVE
  bool "Dump waveform during execution"
  default n

endmenu
```
